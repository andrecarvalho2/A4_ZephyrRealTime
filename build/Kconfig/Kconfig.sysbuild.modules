## build/Kconfig/Kconfig.sysbuild.modules
```kconfig
menu "nrf (/home/andre/ncs/v2.6.1/nrf)"
osource "/home/andre/ncs/v2.6.1/nrf/sysbuild/Kconfig.sysbuild"
config ZEPHYR_NRF_MODULE
	bool
	default y
endmenu
```
